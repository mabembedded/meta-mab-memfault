## conf/layer.conf
```bitbake
# We have a conf and classes directory, add to BBPATH
BBPATH .= ":${LAYERDIR}"

# We have a packages directory, add to BBFILES
BBFILES += "${LAYERDIR}/recipes-*/*/*.bb \
            ${LAYERDIR}/recipes-*/*/*.bbappend"

BBFILE_COLLECTIONS += "memfault-rpi"
BBFILE_PATTERN_memfault-rpi := "^${LAYERDIR}/"
BBFILE_PRIORITY_memfault-rpi = "6"

LAYERDEPENDS_meta-memfault-rpi  = "core"
LAYERDEPENDS_meta-memfault-rpi += "openembedded-layer raspberrypi swupdate"

LAYERSERIES_COMPAT_meta-memfault-rpi = "dunfell"

include conf/machine/meta-memfault-rpi.conf
```

## conf/machine/memfault-rpi.conf
```bitbake
RPI_KERNEL_DEVICETREE_OVERLAYS += "\
    overlays/uart0.dtbo \
"

RPI_USE_U_BOOT = "1"
ENABLE_UART = "1"
KERNEL_IMAGETYPE = "uImage"
```

## wic/memfault-rpi.wks
```
# short-description: Create Raspberry Pi SD card image
# long-description: Creates a partitioned SD card image for use with
# Raspberry Pi. Boot files are located in the first vfat partition.

part /boot --source bootimg-partition --ondisk mmcblk0 --fstype=vfat --label boot --active --align 4096 --size 20
part / --size 2G --source rootfs --ondisk mmcblk0 --fstype=ext4 --label root --align 4096 --exclude-path=data/
part --size 2G --source rootfs --ondisk mmcblk0 --fstype=ext4 --label root2 --align 4096 --exclude-path=data/
part /data --size 2G --source rootfs --rootfs-dir=${IMAGE_ROOTFS}/data --ondisk mmcblk0 --fstype=ext4 --label data --align 4096
```
